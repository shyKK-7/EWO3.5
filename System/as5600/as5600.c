/*
	应用说明：
	在访问I2C设备前，请先调用 i2c_CheckDevice() 检测I2C设备是否正常，该函数会配置GPIO

*/
#include "./as5600/as5600.h"


float Speed;
float LastAngle,NowAngle;



/*
*********************************************************************************************************
*	函 数 名: i2c_Delay
*	功能说明: I2C总线位延迟，最快400KHz
*	形    参：无
*	返 回 值: 无
*********************************************************************************************************
*/
static void i2c_Delay(void)
{
	uint8_t i;

	/*　
	 	下面的时间是通过逻辑分析仪测试得到的。
    工作条件：CPU主频72MHz ，MDK编译环境，1级优化
  
		循环次数为10时，SCL频率 = 205KHz 
		循环次数为7时，SCL频率 = 347KHz， SCL高电平时间1.5us，SCL低电平时间2.87us 
	 	循环次数为5时，SCL频率 = 421KHz， SCL高电平时间1.25us，SCL低电平时间2.375us 
	*/
	for (i = 0; i < 10; i++);
}

/*
*********************************************************************************************************
*	函 数 名: i2c_Start
*	功能说明: CPU发起I2C总线启动信号
*	形    参：无
*	返 回 值: 无
*********************************************************************************************************
*/
void i2c_Start(void)
{
	/* 当SCL高电平时，SDA出现一个下跳沿表示I2C总线启动信号 */
	AS5600_I2C_SDA_1();
	AS5600_I2C_SCL_1();
	i2c_Delay();
	AS5600_I2C_SDA_0();
	i2c_Delay();
	AS5600_I2C_SCL_0();
	i2c_Delay();
}

/*
*********************************************************************************************************
*	函 数 名: i2c_Start
*	功能说明: CPU发起I2C总线停止信号
*	形    参：无
*	返 回 值: 无
*********************************************************************************************************
*/
void i2c_Stop(void)
{
	/* 当SCL高电平时，SDA出现一个上跳沿表示I2C总线停止信号 */
	AS5600_I2C_SDA_0();
	AS5600_I2C_SCL_1();
	i2c_Delay();
	AS5600_I2C_SDA_1();
}

/*
*********************************************************************************************************
*	函 数 名: i2c_SendByte
*	功能说明: CPU向I2C总线设备发送8bit数据
*	形    参：_ucByte ： 等待发送的字节
*	返 回 值: 无
*********************************************************************************************************
*/
void i2c_SendByte(uint8_t _ucByte)
{
	uint8_t i;

	/* 先发送字节的高位bit7 */
	for (i = 0; i < 8; i++)
	{		
		if (_ucByte & 0x80)
		{
			AS5600_I2C_SDA_1();
		}
		else
		{
			AS5600_I2C_SDA_0();
		}
		i2c_Delay();
		AS5600_I2C_SCL_1();
		i2c_Delay();	
		AS5600_I2C_SCL_0();
		if (i == 7)
		{
			 AS5600_I2C_SDA_1(); // 释放总线
		}
		_ucByte <<= 1;	/* 左移一个bit */
		i2c_Delay();
	}
}

/*
*********************************************************************************************************
*	函 数 名: i2c_ReadByte
*	功能说明: CPU从I2C总线设备读取8bit数据
*	形    参：无
*	返 回 值: 读到的数据
*********************************************************************************************************
*/
uint8_t i2c_ReadByte(void)
{
	uint8_t i;
	uint8_t value;

	/* 读到第1个bit为数据的bit7 */
	value = 0;
	for (i = 0; i < 8; i++)
	{
		value <<= 1;
		AS5600_I2C_SCL_1();
		i2c_Delay();
		if (AS5600_I2C_SDA_READ())
		{
			value++;
		}
		AS5600_I2C_SCL_0();
		i2c_Delay();
	}
	return value;
}

/*
*********************************************************************************************************
*	函 数 名: i2c_WaitAck
*	功能说明: CPU产生一个时钟，并读取器件的ACK应答信号
*	形    参：无
*	返 回 值: 返回0表示正确应答，1表示无器件响应
*********************************************************************************************************
*/
uint8_t i2c_WaitAck(void)
{
	uint8_t re;

	AS5600_I2C_SDA_1();	/* CPU释放SDA总线 */
	i2c_Delay();
	AS5600_I2C_SCL_1();	/* CPU驱动SCL = 1, 此时器件会返回ACK应答 */
	i2c_Delay();
	if (AS5600_I2C_SDA_READ())	/* CPU读取SDA口线状态 */
	{
		re = 1;
	}
	else
	{
		re = 0;
	}
	AS5600_I2C_SCL_0();
	i2c_Delay();
	return re;
}

/*
*********************************************************************************************************
*	函 数 名: i2c_Ack
*	功能说明: CPU产生一个ACK信号
*	形    参：无
*	返 回 值: 无
*********************************************************************************************************
*/
void i2c_Ack(void)
{
	AS5600_I2C_SDA_0();	/* CPU驱动SDA = 0 */
	i2c_Delay();
	AS5600_I2C_SCL_1();	/* CPU产生1个时钟 */
	i2c_Delay();
	AS5600_I2C_SCL_0();
	i2c_Delay();
	AS5600_I2C_SDA_1();	/* CPU释放SDA总线 */
}

/*
*********************************************************************************************************
*	函 数 名: i2c_NAck
*	功能说明: CPU产生1个NACK信号
*	形    参：无
*	返 回 值: 无
*********************************************************************************************************
*/
void i2c_NAck(void)
{
	AS5600_I2C_SDA_1();	/* CPU驱动SDA = 1 */
	i2c_Delay();
	AS5600_I2C_SCL_1();	/* CPU产生1个时钟 */
	i2c_Delay();
	AS5600_I2C_SCL_0();
	i2c_Delay();	
}

/*
*********************************************************************************************************
*	函 数 名: i2c_CheckDevice
*	功能说明: 检测I2C总线设备，CPU向发送设备地址，然后读取设备应答来判断该设备是否存在
*	形    参：_Address：设备的I2C总线地址
*	返 回 值: 返回值 0 表示正确， 返回1表示未探测到
*********************************************************************************************************
*/
uint8_t i2c_CheckDevice(uint8_t _Address)
{
	uint8_t ucAck;

	As5600_Init();		/* 配置GPIO */

	
	i2c_Start();		/* 发送启动信号 */

	/* 发送设备地址+读写控制bit（0 = w， 1 = r) bit7 先传 */
	i2c_SendByte(_Address | AS5600_I2C_WR);
	ucAck = i2c_WaitAck();	/* 检测设备的ACK应答 */

	i2c_Stop();			/* 发送停止信号 */

	return ucAck;
}

/*
*********************************************************************************************************
*	函 数 名: As5600_Init
*	功能说明: 配置I2C总线的GPIO，采用模拟IO的方式实现，同时配置定时器7
*	形    参：无
*	返 回 值: 无
*********************************************************************************************************
*/
void As5600_Init(void)
{
	GPIO_InitTypeDef GPIO_InitStructure;

	RCC_AHB1PeriphClockCmd(AS5600_I2C_CLK, ENABLE);	/* 打开GPIO时钟 */

	GPIO_InitStructure.GPIO_Pin = AS5600_I2C_SCL_PIN | AS5600_I2C_SDA_PIN;
	GPIO_InitStructure.GPIO_Speed = GPIO_Speed_50MHz;
    GPIO_InitStructure.GPIO_OType = GPIO_OType_PP;
    GPIO_InitStructure.GPIO_Mode = GPIO_Mode_OUT;
    GPIO_InitStructure.GPIO_PuPd = GPIO_PuPd_UP;
	GPIO_Init(AS5600_I2C_PORT, &GPIO_InitStructure);

	/* 给一个停止信号, 复位I2C总线上的所有设备到待机模式 */
	i2c_Stop();
	NowAngle=(AS5600_ReadTwoByte(_raw_ang_hi,_raw_ang_lo)*360)/4096;
}

/*
*********************************************************************************************************
*	函 数 名: AS5600_ReadOneByte
*	功能说明: 获取AS5600得一个字节
*	形    参：无
*	返 回 值: 无
*********************************************************************************************************
*/
uint8_t AS5600_ReadOneByte(u16 ReadAddr)
{                  
  uint8_t temp=0;                                                                                   
  i2c_Start();  
    i2c_SendByte((0X36<<1)|0x00);       //
    i2c_WaitAck(); 
  i2c_SendByte(ReadAddr);   //
    i2c_WaitAck();        
    i2c_Start();              
    i2c_SendByte((0X36<<1)|0x01);           //           
    i2c_WaitAck();     
  temp=i2c_ReadByte();           
  i2c_Stop();//       
    return temp;
}

/*
*********************************************************************************************************
*	函 数 名: AS5600_ReadTwoByte
*	功能说明: 获取AS5600得两个字节
*	形    参：无
*	返 回 值: 无
*********************************************************************************************************
*/
uint16_t AS5600_ReadTwoByte(u16 ReadAddr_hi,u16 ReadAddr_lo)
{
    uint16_t TwoByte_Data=0;
    u8 hi_Data=0,lo_Data=0;
    hi_Data=AS5600_ReadOneByte(ReadAddr_hi);
    lo_Data=AS5600_ReadOneByte(ReadAddr_lo);
    TwoByte_Data = (hi_Data<<8)|lo_Data;
    return TwoByte_Data;
}


/*
*********************************************************************************************************
*	函 数 名: AS5600_Read_Speed
*	功能说明: 读取速度，存放在Speed
*	形    参：无
*	返 回 值: 角速度
*********************************************************************************************************
*/
float AS5600_Read_Speed(void)
{
	LastAngle = NowAngle;
	NowAngle = AS5600_ReadTwoByte(_raw_ang_hi,_raw_ang_lo)*0.08789;
    Speed = NowAngle - LastAngle;
    if (Speed > 180) 
    {
        Speed -= 360;  // 处理从 360 回到 0 度的情况
    } 
    else if (Speed < -180) 
    {
        Speed += 360;  // 处理从 0 跳到 360 度的情况
    }
   return Speed;
}

int AS5600_GetAngle(void)
{
    return (AS5600_ReadTwoByte(_raw_ang_hi,_raw_ang_lo)*360)/4096;
}
